## config/boards/shields/eebkeeb/Kconfig.defconfig
```kconfig
if SHIELD_EEBKEEB

config ZMK_KEYBOARD_NAME
  default "EEBKEEB"
CONFIG_ZMK_RGB_UNDERGLOW=y
CONFIG_ZMK_RGB_UNDERGLOW_EFF_START=2
CONFIG_ZMK_RGB_UNDERGLOW_BRT_MAX=100
endif
```

## config/boards/shields/eebkeeb/Kconfig.shield
```kconfig
config SHIELD_EEBKEEB
  def_bool $(shields_list_contains, EEBKEEB)

CONFIG_ZMK_RGB_UNDERGLOW=y
CONFIG_ZMK_RGB_UNDERGLOW_EFF_START=0
```
